## arch/arm/mach-rk30/Kconfig
```kconfig
if ARCH_RK30

config ARCH_RK30XX
	depends on ARCH_RK30
	bool

config ARCH_RK3066B
	depends on ARCH_RK30
	bool

choice
	prompt "Rockchip SoC Type"
	depends on ARCH_RK30
	default SOC_RK3066

config SOC_RK3000
	bool "RK3000"
	select ARCH_RK30XX

config SOC_RK3066
	bool "RK3066"
	select ARCH_RK30XX

config SOC_RK3068
	bool "RK3068"
	select ARCH_RK30XX

config SOC_RK3066B
	bool "RK3066B"
	select ARCH_RK3066B
	select USB_ARCH_HAS_EHCI

config SOC_RK3108
	bool "RK3108"
	select ARCH_RK3066B

endchoice

config IAM_CHANGES
	bool

choice
	prompt "RK30xx Board Type"
	depends on ARCH_RK30XX
	default MACH_RK30_SDK

config MACH_RK30_SDK
	bool "RK30 SDK board"
	select HAVE_PWM
	select LEDS_CLASS
	select NEW_LEDS
	select IAM_CHANGES

config MACH_RK3066_SDK
	bool "RK3066 SDK board"

config MACH_RK30_DS1001B
        bool "RK30 DS1001B board"

config MACH_RK30_PHONE_PAD
        bool "RK30 smart phone pad board"

config MACH_RK30_PHONE
	bool "RK30 smart phone board"

config MACH_RK30_PHONE_LOQUAT
	bool "RK30 smart phone loquat board"

config MACH_RK30_PHONE_A22
        bool "RK30 smart phone a22 board"

config MACH_PIPO_M3
	bool "Pipo M3 MID device"
	
config MACH_RK30_CUBE_U30GT
        bool "Cube U30GT MID"
	
config MACH_ODYS_GENIO
        bool "Odys Genio MID device"
	
endchoice

choice
	prompt "RK30 phone pad board type"
	depends on MACH_RK30_PHONE_PAD
	default MACH_RK30_PHONE_PAD_DS763

	config MACH_RK30_PHONE_PAD_DS763
	bool "ds763"

	config MACH_RK30_PHONE_PAD_C8003
	bool "c8003"

endchoice


if SOC_RK3066B
choice
	prompt "RK3066B Board Type"

config MACH_RK3066B_FPGA
	bool "RK3066B FPGA board"
	select RK_FPGA

config MACH_RK3066B_SDK
	bool "RK3066B SDK board"

config MACH_RK3066B_M701
	bool "RK3066B M701 board"

endchoice
endif

if SOC_RK3108
choice
	prompt "RK3108 Board Type"

config MACH_RK3108_TB
	bool "RK3108 Top Board"

endchoice
endif

endif
```

## drivers/net/wireless/Kconfig
```kconfig
#
# Wireless LAN device configuration
#

menuconfig WLAN
	bool "Wireless LAN"
	depends on !S390
	depends on NET
	select WIRELESS
	default y
	---help---
	  This section contains all the pre 802.11 and 802.11 wireless
	  device drivers. For a complete list of drivers and documentation
	  on them refer to the wireless wiki:

	  http://wireless.kernel.org/en/users/Drivers

if WLAN

config WLAN_80211
	bool "Wireless LAN (IEEE 802.11)"
	depends on NETDEVICES
	---help---
	  Say Y if you have any 802.11 wireless LAN hardware.

	  This option does not affect the kernel build, it only
	  lets you choose drivers.

config AIDC
    bool "Enable WIFI AIDS(Automatic Identification USB Wifi Type)"
	depends on RTL8188EU || RTL8192CU || RTL8723AU || RT5370
	depends on !RK_CHECK_UACCESS
	default n
	---help---

config BCM_OOB_ENABLED
	bool "Enable wifi host wake up function"
	depends on RKWIFI
	select RK29_SDIO_IRQ_FROM_GPIO
	default y
	---help---

	config BCM4329
	  depends on WLAN_80211 && MMC
	  select WIRELESS_EXT
	  select WEXT_PRIV
	  select IEEE80211
	  select FW_LOADER
	  bool "Broadcom BCM4329 WiFi/BT Combo SDIO"
	  ---help---
	    A library for Broadcom BCM4329 SDIO WLAN/BT combo devices.
	    So far, the following modules have been verified:
	      (1) Samsung    SWL-B23
	      
	config BCM4319
	  depends on WLAN_80211 && MMC
	  select WIRELESS_EXT
	  select WEXT_PRIV
	  select IEEE80211
	  select FW_LOADER
	  bool "Broadcom BCM4319 WiFi SDIO"
	  ---help---
	    A library for Broadcom BCM4319 SDIO WLAN devices. 

        config MT6620
          depends on WLAN_80211 && MMC
          select WIRELESS_EXT
          select WEXT_PRIV
          select IEEE80211
          select FW_LOADER
          bool "MTK MT6620 WiFi SDIO"
          ---help---
            A library for MTK_wcn_combo SDIO WLAN devices.
	config RDA5990
	  depends on WLAN_80211 && MMC
	  select WIRELESS_EXT
	  select WEXT_PRIV
	  select IEEE80211
	  bool "rda 5990p"
	  ---help---
	    rda5990P fm bt wifi
	    
	config MV8686
	  depends on WLAN_80211 && MMC
	  select WIRELESS_EXT
	  select IEEE80211
	  select FW_LOADER
	  bool "Marvell MV8686 SDIO"
	  ---help---
	    A library for Marvell 8686 SDIO WLAN devices.
	    So far, the following modules have been verified:
	      (1) Samsung    SWL-2480
	      (2) Azurewave  AW-GH321
	      (3) USI        WM-G-MR-09
	      (4) Murata     SP-8HEP-P

	config RTL8189ES
        tristate "Realtek 8189ES SDIO WiFi Support"
        depends on WLAN_80211 && MMC
        select WIRELESS_EXT
        select WEXT_PRIV
        select IEEE80211
        select CFG80211
        select MAC80211
        ---help---

source "drivers/net/wireless/brcm80211/Kconfig"
source "drivers/net/wireless/rkwifi/Kconfig"
source "drivers/net/wireless/bcm40181/Kconfig"
source "drivers/net/wireless/mt5931/Kconfig"
source "drivers/net/wireless/rkusbwifi/rtl8192cu/Kconfig"
source "drivers/net/wireless/rkusbwifi/rtl8192du/Kconfig"
source "drivers/net/wireless/rkusbwifi/rtl8188eu/Kconfig"
source "drivers/net/wireless/rkusbwifi/rtl8723au/Kconfig"
source "drivers/net/wireless/rkusbwifi/rtl8723bu/Kconfig"
source "drivers/net/wireless/rkusbwifi/rt5370/Kconfig"
source "drivers/net/wireless/rkusbwifi/mt7601/Kconfig"
source "drivers/net/wireless/ar6003/Kconfig"
source "drivers/net/wireless/rtl8723as/Kconfig"
source "drivers/net/wireless/rtl8723bs/Kconfig"
source "drivers/net/wireless/esp8089/Kconfig"

menuconfig MTK_WIRELESS_SOLUTION	
	bool "MTK wireless chip configuration"
	help
	  "enable/disable and config MTK wireless solution"

if MTK_WIRELESS_SOLUTION
source "drivers/net/wireless/combo_mt66xx/Kconfig"
source "drivers/net/wireless/mt5931_kk/Kconfig"
endif # MTK_WIRELESS_SOLUTION

config RTL8723AU_LW
	tristate "Realtek 8723AU USB WiFi Support"
	depends on USB
    select WIRELESS_EXT
    select WEXT_PRIV
    select IEEE80211
    select BT_RTKBTUSB
    select UHID
	---help---
	  Help message of RTL8723AU

config RTL8188EU_LW
	tristate "Realtek 8188EU USB WiFi Support"
	depends on USB
    select WIRELESS_EXT
    select WEXT_PRIV
    select IEEE80211
    select BT_RTKBTUSB
    select UHID
	---help---
	  Help message of RTL8188EU
endif
```

## drivers/net/wireless/rkwifi/Kconfig
```kconfig
menuconfig RKWIFI
	bool "RK901/RK903/BCM4330/AP6XXX wireless cards support"
	depends on MMC && WLAN_80211
	select WIRELESS_EXT
	select WEXT_PRIV

config RK_CFG80211
	bool "Enable NL80211 support"
	default y
	depends on RKWIFI
	select CFG80211
	select MAC80211
	help
	  Enables CFG80211 support

config RKWIFI_BLD
	tristate "Build RK901/RK903/BCM4330/AP6XXX wireless cards"
	depends on RKWIFI
	---help---
	  This module adds support for wireless adapters based on
	  Broadcom 4329/30 chipset.
	  If you choose to build a module, it'll be called dhd. Say M if
	  unsure.


choice	
	depends on RKWIFI_BLD && WLAN_80211
	prompt "Select the wifi module"
	default RK903
	
	config BCM4330 
	    bool "BCM4330"
	    depends on RKWIFI_BLD && WLAN_80211

	config RK903
	    bool "RK903"
	    depends on RKWIFI_BLD && WLAN_80211

	config RK901
	    bool "RK901"
	    depends on RKWIFI_BLD && WLAN_80211
	
	config AP6181
	    bool "AP6181"
	    depends on RKWIFI_BLD && WLAN_80211

	config AP6210
	    bool "AP6210"
	    depends on RKWIFI_BLD && WLAN_80211

	config AP6234
		bool "AP6234"
		depends on RKWIFI_BLD

	config AP6330
		bool "AP6330"
		depends on RKWIFI_BLD && WLAN_80211

	config AP6335
		bool "AP6335"
		depends on RKWIFI_BLD

	config AP6441
		bool "AP6441"
		depends on RKWIFI_BLD

	config AP6476
		bool "AP6476"
		depends on RKWIFI_BLD && WLAN_80211

	config AP6493
		bool "AP6493"
		depends on RKWIFI_BLD && WLAN_80211

	config GB86302I
		bool "GB86302I"
		depends on RKWIFI_BLD && WLAN_80211

endchoice

choice
	depends on RKWIFI_BLD && WLAN_80211
	prompt "Select the wifi module crystal freq"
	default RKWIFI_26M

	config RKWIFI_37_4M
    	bool "37_4M"
	    depends on RKWIFI_BLD && WLAN_80211

	config RKWIFI_26M
    	bool "26M"
	    depends on RKWIFI_BLD && WLAN_80211

	config RKWIFI_24M
    	bool "24M"
	    depends on RKWIFI_BLD && WLAN_80211

endchoice

menuconfig RKWIFI_FW_SET_PATH
	bool "Set path to WiFi firmwares"
	default n
	depends on RKWIFI_BLD

config RKWIFI_FW_PATH
	string ""
	default "/lib/firmware"
	depends on RKWIFI_FW_SET_PATH
	help
	  Linux path to firmwares
```

## drivers/video/display/tve/Kconfig
```kconfig
config RK610_TVOUT
	bool "RK610(Jetta) tvout support"
	depends on MFD_RK610
	default y if MFD_RK610
	help
		Support Jetta(RK610) to output YPbPr and CVBS.
		
config RK610_TVOUT_YPbPr
	bool "support YPbPr output"
	depends on RK610_TVOUT
config RK610_TVOUT_CVBS
	bool "support CVBS output"
	depends on RK610_TVOUT


menuconfig RK_TVENCODER
	bool "TV Encoder support"
    help
       Support RockChip TV Encoder if you say y here.

source "drivers/video/display/tve/rk1000/Kconfig"
```
